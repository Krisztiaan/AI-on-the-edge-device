## code/components/jomjol_fileserver_ota/Kconfig
```kconfig
menu "AI-on-the-edge-device OTA/File Server"

config JOMJOL_ENABLE_ZIP_UPDATES
    bool "Enable ZIP-based updates (html.zip / update.zip)"
    default y
    help
        Enables handling ZIP files for updates, including extracting html.zip and
        ZIP-based update bundles. Disable to reduce firmware size if you only
        use raw firmware.bin updates / online update.

endmenu
```

## neo/components/neo_app/Kconfig
```kconfig
menu "NEO"

config NEO_ENABLE_HTTP
    bool "Enable local HTTP management UI"
    default y

config NEO_ENABLE_SOFTAP
    bool "Enable SoftAP provisioning"
    default y

config NEO_SOFTAP_SSID
    string "SoftAP SSID"
    default "ai-meter-neo"
    depends on NEO_ENABLE_SOFTAP

config NEO_SOFTAP_PASSWORD
    string "SoftAP password (empty = open)"
    default ""
    depends on NEO_ENABLE_SOFTAP

endmenu
```

## neo/sdkconfig.defaults
```kconfig
# Keep defaults minimal until features are added.
# (We will add explicit feature-gated defaults as NEO grows.)

CONFIG_MBEDTLS_CERTIFICATE_BUNDLE=y

# ESP32-CAM is a 4MB flash part; keep Kconfig aligned to avoid boot/runtime mismatch warnings.
CONFIG_ESPTOOLPY_FLASHSIZE_4MB=y
CONFIG_ESPTOOLPY_FLASHSIZE="4MB"
```
